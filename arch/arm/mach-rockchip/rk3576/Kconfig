## arch/arm/mach-rockchip/rk3576/Kconfig
```kconfig
if ROCKCHIP_RK3576

config TARGET_EVB_RK3576
	bool "EVB_RK3576"
	select BOARD_LATE_INIT
	help
	  RK3576 EVB is a evaluation board for Rockchp RK3576.

config TARGET_VIOLOOP_RK3576_VLA11
	bool "VIOLOOP_RK3576_VLA11"
	select BOARD_LATE_INIT
	help
	  Violoop RK3576 VLA11 product hardware.

config SYS_SOC
	default "rockchip"

config SYS_MALLOC_F_LEN
	default 0x400

source board/rockchip/evb_rk3576/Kconfig
source board/rockchip/violoop_rk3576_vla11/Kconfig

endif
```

## board/rockchip/violoop_rk3576_tl_v4/Kconfig
```kconfig
if TARGET_VIOLOOP_RK3576_TL_V4

config SYS_BOARD
	default "violoop_rk3576_tl_v4"

config SYS_VENDOR
	default "rockchip"

config SYS_CONFIG_NAME
	default "violoop_rk3576_tl_v4"

config BOARD_SPECIFIC_OPTIONS
	def_bool y

endif
```

## board/rockchip/violoop_rk3576_vla11/Kconfig
```kconfig
if TARGET_VIOLOOP_RK3576_VLA11

config SYS_BOARD
	default "violoop_rk3576_vla11"

config SYS_VENDOR
	default "rockchip"

config SYS_CONFIG_NAME
	default "violoop_rk3576_vla11"

config BOARD_SPECIFIC_OPTIONS
	def_bool y

config VIOLOOP_VLA11_LCD_RECOVERY
	bool "Check and recover VLA11 LCD state after Logo output starts"
	depends on OF_BOARD_SETUP && DRM_ROCKCHIP
	depends on DRM_ROCKCHIP_DW_MIPI_DSI2 && DRM_ROCKCHIP_PANEL
	default n
	help
	  Perform one bounded, panel-ID-qualified LCD status check after the
	  VLA11 Logo data stream starts. Recover verified image/power-mode
	  faults and pass the diagnostic report to Linux through /chosen.
	  The feature is excluded from SPL/TPL and leaves other boards alone.

endif
```
